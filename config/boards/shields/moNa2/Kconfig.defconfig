## config/boards/shields/moNa2/Kconfig.defconfig
```kconfig
if SHIELD_MONA2_R

config ZMK_KEYBOARD_NAME
    default "roba_R"

config ZMK_SPLIT
    default y

config ZMK_SPLIT_ROLE_CENTRAL
    default y

endif

if SHIELD_MONA2_L

config ZMK_KEYBOARD_NAME
    default "roba_L"

config ZMK_SPLIT
    default y

endif
```

## config/boards/shields/moNa2/Kconfig.shield
```kconfig
config SHIELD_MONA2_R
    def_bool $(shields_list_contains,roba_R)

config SHIELD_MONA2_L
    def_bool $(shields_list_contains,roba_L)
```
